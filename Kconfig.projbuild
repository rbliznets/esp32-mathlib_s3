## Kconfig.projbuild
```kconfig
menu "mathlib_s3"

    config MLIB_CHECK_PARAM
        bool "Enable check function params."
        default n
        help
            Disable for benchmark.

       
endmenu
```
